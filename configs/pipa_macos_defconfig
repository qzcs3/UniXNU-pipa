## configs/pipa_macos_defconfig
```kconfig
CONFIG_XNU_BUILD_ARCHIVES=y
CONFIG_XNU_CRYPTO_BOOTSTRAP="source"
CONFIG_XNU_DT_PANIC_REGION=y
CONFIG_XNU_ARMVIRT_PLATFORM=n
# CONFIG_XNU_KERNEL_CHAINED_FIXUPS is not set
CONFIG_XNU_SOURCE_CORECRYPTO14=y
CONFIG_XNU_SOURCE_PTHREAD=y
CONFIG_XNU_ARM_DT_PLATFORM=y
CONFIG_XNU_ARMCPU=y
CONFIG_XNU_NATIVE_AES=n
CONFIG_XNU_TRUST_CACHE_RUNTIME=y
CONFIG_XNU_NATIVE_CS_HASH_CACHE=y
CONFIG_XNU_NATIVE_ARCH_TIMER=y
CONFIG_XNU_NATIVE_PAN=y
CONFIG_XNU_SHENG_PMGR=y
CONFIG_XNU_BOOT_PROGRESS=y
CONFIG_XNU_BOOT_PROGRESS_STANDALONE=y
CONFIG_XNU_NATIVE_LEGACY_DISPLAY=n
CONFIG_XNU_NATIVE_UFS=y
CONFIG_XNU_NATIVE_UFS_ARCHIVE="{tree}/build/pipa-ufs/libPipaUfs.a"
CONFIG_XNU_NATIVE_VIRTIO_BLOCK=n
CONFIG_XNU_NATIVE_RAM_BLOCK=n
CONFIG_XNU_VERIFIED_ROOT_PROBE=n
CONFIG_XNU_OWNER_ROOT_AUDIT=n
CONFIG_XNU_OWNER_ROOT_TRUST=n
CONFIG_XNU_OWNER_CACHE_MOUNT=n
CONFIG_XNU_OWNER_CACHE_STARTUP=n
CONFIG_XNU_OWNER_BOOT_MANIFEST=n
CONFIG_XNU_OWNER_DATA_MOUNT=n
CONFIG_XNU_OWNER_UNION_SYSTEMOS=n
CONFIG_XNU_OWNER_CACHE_VOLUME_UUID="6678E466-2F88-4C56-9408-DC7361BAA0BA"
CONFIG_XNU_OWNER_DATA_VOLUME_UUID="79157BD4-6A8C-45D6-A0EB-11FEA89BDE46"
CONFIG_XNU_EXTRA_LD_ARCHIVES="{tree}/build/link-stubs/libLinkStubs.a"
CONFIG_XNU_NATIVE_MOBILE_DISPLAY=n
CONFIG_XNU_NATIVE_ADRENO=y
CONFIG_XNU_NATIVE_ADRENO_ARCHIVE="{tree}/build/adreno650/libAdreno650.a"
```
